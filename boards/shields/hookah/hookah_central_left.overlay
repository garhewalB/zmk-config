#include "hookah.dtsi"

&kscan0 {
    col-gpios
        = <&pro_micro 21 GPIO_ACTIVE_HIGH>
        , <&pro_micro 2 GPIO_ACTIVE_HIGH>
        , <&pro_micro 3 GPIO_ACTIVE_HIGH>
        , <&pro_micro 20 GPIO_ACTIVE_HIGH>
        , <&pro_micro 5 GPIO_ACTIVE_HIGH>
        , <&pro_micro 18 GPIO_ACTIVE_HIGH>
        ;
};

&left_encoder {
    status = "okay";
};

&tpoint_listener {
    status = "okay";
};