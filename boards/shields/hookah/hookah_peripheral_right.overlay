#include "hookah.dtsi"
#include "hookah_tpoint0_ps2.dtsi"

&kscan0 {
    col-gpios
        = <&pro_micro 18 GPIO_ACTIVE_HIGH>
        , <&pro_micro 5 GPIO_ACTIVE_HIGH>
        , <&pro_micro 20 GPIO_ACTIVE_HIGH>
        , <&pro_micro 3 GPIO_ACTIVE_HIGH>
        , <&pro_micro 2 GPIO_ACTIVE_HIGH>
        , <&pro_micro 21 GPIO_ACTIVE_HIGH>
        ;
};

&default_transform {
    col-offset = <6>;
};

&right_encoder {
    status = "okay";
};

&tpoint_split { device = <&tpoint0>; };

#include <zephyr/dt-bindings/input/input-event-codes.h>