#include "colubris_mini.dtsi"
#include <input/processors.dtsi>
#include <zephyr/dt-bindings/input/input-event-codes.h>

&kscan0 {
    input-gpios
            // R2
        = <&pro_micro 20 (GPIO_ACTIVE_LOW | GPIO_PULL_UP)>
        , <&pro_micro 15 (GPIO_ACTIVE_LOW | GPIO_PULL_UP)>
        , <&pro_micro 2 (GPIO_ACTIVE_LOW | GPIO_PULL_UP)>
        , <&pro_micro 5 (GPIO_ACTIVE_LOW | GPIO_PULL_UP)>

        // R3
        , <&pro_micro 21 (GPIO_ACTIVE_LOW | GPIO_PULL_UP)> 
        , <&pro_micro 19 (GPIO_ACTIVE_LOW | GPIO_PULL_UP)>
        , <&pro_micro 14 (GPIO_ACTIVE_LOW | GPIO_PULL_UP)>
        , <&pro_micro 3 (GPIO_ACTIVE_LOW | GPIO_PULL_UP)>
        , <&pro_micro 6 (GPIO_ACTIVE_LOW | GPIO_PULL_UP)>

        // R4
        , <&pro_micro 18 (GPIO_ACTIVE_LOW | GPIO_PULL_UP)>
        , <&pro_micro 16 (GPIO_ACTIVE_LOW | GPIO_PULL_UP)>
        , <&pro_micro 4 (GPIO_ACTIVE_LOW | GPIO_PULL_UP)>

        // Thumb
        , <&pro_micro 7 (GPIO_ACTIVE_LOW | GPIO_PULL_UP)>
        ;
};

&default_transform {
    col-offset = <13>;
};

