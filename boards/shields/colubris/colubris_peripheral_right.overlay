#include "colubris.dtsi"
#include "colubris_tpoint0_ps2.dtsi"
#include <input/processors.dtsi>
#include <zephyr/dt-bindings/input/input-event-codes.h>

// Old version
// &kscan0 {
//     input-gpios
//         = <&pro_amicro 2 (GPIO_ACTIVE_LOW | GPIO_PULL_UP)>
//         , <&pro_micro 4 (GPIO_ACTIVE_LOW | GPIO_PULL_UP)>
//         , <&pro_micro 5 (GPIO_ACTIVE_LOW | GPIO_PULL_UP)>
//         , <&pro_micro 19 (GPIO_ACTIVE_LOW | GPIO_PULL_UP)>
//         , <&pro_micro 21 (GPIO_ACTIVE_LOW | GPIO_PULL_UP)>
//         , <&pro_micro 20 (GPIO_ACTIVE_LOW | GPIO_PULL_UP)>
//         , <&pro_micro 18 (GPIO_ACTIVE_LOW | GPIO_PULL_UP)>
//         , <&pro_micro 16 (GPIO_ACTIVE_LOW | GPIO_PULL_UP)>
//         , <&pro_micro 6 (GPIO_ACTIVE_LOW | GPIO_PULL_UP)> 
//         , <&pro_micro 3 (GPIO_ACTIVE_LOW | GPIO_PULL_UP)>
//         , <&pro_micro 15 (GPIO_ACTIVE_LOW | GPIO_PULL_UP)>
//         , <&pro_micro 14 (GPIO_ACTIVE_LOW | GPIO_PULL_UP)>
//         , <&pro_micro 7 (GPIO_ACTIVE_LOW | GPIO_PULL_UP)>
//         // This GPIO pin on one of my N!N is blown.
//         //, <&pro_micro 9 (GPIO_ACTIVE_LOW | GPIO_PULL_UP)>
//         , <&pro_micro 10 (GPIO_ACTIVE_LOW | GPIO_PULL_UP)>
//         , <&pro_micro 8 (GPIO_ACTIVE_LOW | GPIO_PULL_UP)>
//         ;
// };

&kscan0 {
    input-gpios
        = <&pro_micro 21 (GPIO_ACTIVE_LOW | GPIO_PULL_UP)>
        , <&pro_micro 19 (GPIO_ACTIVE_LOW | GPIO_PULL_UP)>
        , <&pro_micro 18 (GPIO_ACTIVE_LOW | GPIO_PULL_UP)>
        , <&pro_micro 4 (GPIO_ACTIVE_LOW | GPIO_PULL_UP)>
        , <&pro_micro 5 (GPIO_ACTIVE_LOW | GPIO_PULL_UP)>
        , <&pro_micro 8 (GPIO_ACTIVE_LOW | GPIO_PULL_UP)>
        , <&pro_micro 14 (GPIO_ACTIVE_LOW | GPIO_PULL_UP)>
        , <&pro_micro 2 (GPIO_ACTIVE_LOW | GPIO_PULL_UP)>
        , <&pro_micro 15 (GPIO_ACTIVE_LOW | GPIO_PULL_UP)> 
        , <&pro_micro 20 (GPIO_ACTIVE_LOW | GPIO_PULL_UP)>
        , <&pro_micro 6 (GPIO_ACTIVE_LOW | GPIO_PULL_UP)>
        , <&pro_micro 7 (GPIO_ACTIVE_LOW | GPIO_PULL_UP)>
        , <&pro_micro 3 (GPIO_ACTIVE_LOW | GPIO_PULL_UP)>
        // This GPIO pin on one of my N!N is blown.
        //, <&pro_micro 9 (GPIO_ACTIVE_LOW | GPIO_PULL_UP)>
        , <&pro_micro 10 (GPIO_ACTIVE_LOW | GPIO_PULL_UP)>
        , <&pro_micro 16 (GPIO_ACTIVE_LOW | GPIO_PULL_UP)>
        ;
};

&default_transform {
    col-offset = <15>;
};


// We have the trackpoint on the right peripheral split, so
// set the actual trackpoint as the device for the peripheral. 
&tpoint_split { 
    device = <&tpoint_device>; 

    input-processors = <&zip_xy_swap_mapper>;
};
