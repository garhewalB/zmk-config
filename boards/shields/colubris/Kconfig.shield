## boards/shields/colubris/Kconfig.shield
```kconfig
# Copyright (c) 2020 The ZMK Contributors
# SPDX-License-Identifier: MIT

config SHIELD_COLUBRIS_DONGLE
	def_bool $(shields_list_contains,colubris_dongle)

config SHIELD_COLUBRIS_CENTRAL_LEFT
	def_bool $(shields_list_contains,colubris_central_left)

config SHIELD_COLUBRIS_PERIPHERAL_LEFT
    def_bool $(shields_list_contains,colubris_peripheral_left)

config SHIELD_COLUBRIS_PERIPHERAL_RIGHT
    def_bool $(shields_list_contains,colubris_peripheral_right)
    
```

## boards/shields/colubris_mini/Kconfig.shield
```kconfig
# Copyright (c) 2020 The ZMK Contributors
# SPDX-License-Identifier: MIT

config SHIELD_COLUBRIS_MINI_DONGLE
	def_bool $(shields_list_contains,colubris_mini_dongle)

config SHIELD_COLUBRIS_MINI_CENTRAL_LEFT
	def_bool $(shields_list_contains,colubris_mini_central_left)

config SHIELD_COLUBRIS_MINI_PERIPHERAL_LEFT
    def_bool $(shields_list_contains,colubris_mini_peripheral_left)

config SHIELD_COLUBRIS_MINI_PERIPHERAL_RIGHT
    def_bool $(shields_list_contains,colubris_mini_peripheral_right)
    
```

## boards/shields/colubris_mini_wired/Kconfig.defconfig
```kconfig
if SHIELD_COLUBRIS_MINI_WIRED_CENTRAL_LEFT

config ZMK_KEYBOARD_NAME
    default "Colubris Mini Wired"

config ZMK_SPLIT_ROLE_CENTRAL
    default y

endif

if SHIELD_COLUBRIS_MINI_WIRED_CENTRAL_LEFT || SHIELD_COLUBRIS_MINI_WIRED_PERIPHERAL_RIGHT

config ZMK_SPLIT
    default y

config ZMK_SPLIT_WIRED
    default y


endif
```

## boards/shields/colubris_mini_wired/Kconfig.shield
```kconfig
# Copyright (c) 2020 The ZMK Contributors
# SPDX-License-Identifier: MIT

config SHIELD_COLUBRIS_MINI_WIRED_CENTRAL_LEFT
	def_bool $(shields_list_contains,colubris_mini_wired_central_left)

config SHIELD_COLUBRIS_MINI_WIRED_PERIPHERAL_RIGHT
    def_bool $(shields_list_contains,colubris_mini_wired_peripheral_right)
    
```

## boards/shields/hookah/Kconfig.shield
```kconfig
# Copyright (c) 2020 The ZMK Contributors
# SPDX-License-Identifier: MIT

config SHIELD_HOOKAH_DONGLE
	def_bool $(shields_list_contains,hookah_dongle)

config SHIELD_HOOKAH_CENTRAL_LEFT
	def_bool $(shields_list_contains,hookah_central_left)

config SHIELD_HOOKAH_PERIPHERAL_LEFT
    def_bool $(shields_list_contains,hookah_peripheral_left)

config SHIELD_HOOKAH_PERIPHERAL_RIGHT
    def_bool $(shields_list_contains,hookah_peripheral_right)
    
```

## config/west.yml
```yaml
manifest:
  remotes:
    - name: zmkfirmware
      url-base: https://github.com/zmkfirmware
    # For ZMK dongle with OLED.
    - name: englmaxi
      url-base: https://github.com/englmaxi
    - name: infused-kim
      url-base: https://github.com/infused-kim
    - name: badjeff
      url-base: https://github.com/badjeff
    - name: caksoylar
      url-base: https://github.com/caksoylar
    - name: nmunnich
      url-base: https://github.com/nmunnich
  projects:
    - name: zmk
      remote: zmkfirmware
      revision: v0.3
      # remote: badjeff
      # revision: feat/pointers-with-input-processors
      import: app/west.yml
    - name: zmk-dongle-display
      remote: englmaxi
      revision: main
    - name: kb_zmk_ps2_mouse_trackpoint_driver
      remote: badjeff
      revision: main
    - name: zmk-smart-toggle
      remote: caksoylar
      revision: main
    - name: zmk-component-rp2040-zero
      remote: nmunnich
      revision: main

  self:
    path: config
```
