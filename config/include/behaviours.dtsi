#include <behaviors.dtsi>

/ {
    behaviors {
        lh_pht: left_positional_hold_tap {
            compatible = "zmk,behavior-hold-tap";
            #binding-cells = <2>;
            flavor = "tap-unless-interrupted";
            tapping-term-ms = <100>;                        // <---[[produces tap if held longer than tapping-term-ms]]
            quick-tap-ms = <200>;
            bindings = <&kp>, <&kp>;
            hold-trigger-key-positions = <22 23 24 25 26 27 28 29 30 31 32 33 34 35 36 37 38 39 40 41 42 43>;    // <---[[right-hand keys]]
        };
        
        rh_pht: right_positional_hold_tap{
            compatible = "zmk,behavior-hold-tap";
            #binding-cells = <2>;
            flavor = "tap-unless-interrupted";
            tapping-term-ms = <100>;                        // <---[[produces tap if held longer than tapping-term-ms]]
            quick-tap-ms = <200>;
            bindings = <&kp>, <&kp>;
            hold-trigger-key-positions = <0 1 2 3 4 5 6 7 8 9 10 11 12 13 14 15 16 17 18 19 20 21>;    // <---[[left-hand keys]]
        };
    };
};