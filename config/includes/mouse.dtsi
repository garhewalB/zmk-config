#include <zephyr/dt-bindings/input/input-event-codes.h>
#include <dt-bindings/zmk/mouse.h>
#include <dt-bindings/zmk/input_transform.h>



#ifndef MOVE_Y
#define MOVE_Y(n) (0)
#endif
#ifndef MOVE_X
#define MOVE_X(n) (0)
#endif

#define U_MOUSE_MOVE_MAX 1700
#define MOU_U MOVE_Y(-U_MOUSE_MOVE_MAX)
#define MOU_D MOVE_Y(U_MOUSE_MOVE_MAX)
#define MOU_L MOVE_X(-U_MOUSE_MOVE_MAX)
#define MOU_R MOVE_X(U_MOUSE_MOVE_MAX)

#define U_MOUSE_SCROLL_MAX 20
#define SCL_U MOVE_Y(U_MOUSE_SCROLL_MAX)
#define SCL_D MOVE_Y(-U_MOUSE_SCROLL_MAX)
#define SCL_L MOVE_X(-U_MOUSE_SCROLL_MAX)
#define SCL_R MOVE_X(U_MOUSE_SCROLL_MAX)
